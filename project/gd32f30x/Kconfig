## project/gd32f30x/Kconfig
```kconfig
choice
    prompt "Select a gd32f30x platform project"
    default PROJECT_GD32F30X_NONE
    depends on ARCH_GD32F30X

config PROJECT_GD32F30X_NONE
    bool "None"
    help
      Select this if you do not want to set any project.

config PROJECT_GD32F303_DEMO
    bool "GD32F303 demo project"
    help
        Select this option to enable Module GD32F103 DEMO.
    select PACKAGE_SEGGER_RTT

endchoice


config PROJECT
    string
    default "gd32f30x/gd32f303-demo" if PROJECT_GD32F303_DEMO
```
